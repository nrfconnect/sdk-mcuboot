## boot/zephyr/Kconfig.minimal
```kconfig
# Copyright (c) 2025 Nordic Semiconductor ASA
#
# SPDX-License-Identifier: Apache-2.0
#

if MCUBOOT

config MCUBOOT_MINIMAL
  bool "Configuration to achieve minimal size of MCUboot"
  depends on MCUBOOT
  default n
  help
    Official minimal reference configuration for the most use cases.

if MCUBOOT_MINIMAL

choice MCUBOOT_MINIMAL_VARIANT
  bool "Variant of MCUboot minimal configuration"
  default MCUBOOT_MINIMAL_FIRST

config MCUBOOT_MINIMAL_FIRST
  bool "TODO - first variant"
  help
    TODO - first variant

config MCUBOOT_MINIMAL_SECOND
  bool "TODO - second variant"
  help
    TODO - second variant

endchoice

endif

endif
```

## boot/zephyr/boards/nrf52840_pca20035.conf
```kconfig
# Enable RTT logging
CONFIG_LOG=n

# The build won't fit on the partition allocated for it without size
# optimizations.
CONFIG_SIZE_OPTIMIZATIONS=y
CONFIG_PM_PARTITION_SIZE_MCUBOOT=0x12000

# Serial
CONFIG_SERIAL=y
CONFIG_UART_NRFX=y
CONFIG_UART_INTERRUPT_DRIVEN=y
CONFIG_UART_LINE_CTRL=y

CONFIG_CONSOLE=n
CONFIG_CONSOLE_HANDLER=n
CONFIG_UART_CONSOLE=n

# MCUBoot serial
CONFIG_GPIO=y
CONFIG_MCUBOOT_SERIAL=y
CONFIG_BOOT_SERIAL_CDC_ACM=y
CONFIG_BOOT_SERIAL_DETECT_PORT="GPIO_1"
CONFIG_BOOT_SERIAL_DETECT_PIN=13
CONFIG_BOOT_SERIAL_DETECT_PIN_VAL=0

# Required by USB
CONFIG_MULTITHREADING=y

# USB
CONFIG_USB=y
CONFIG_USB_DEVICE_STACK=y
CONFIG_USB_DEVICE_PRODUCT="MCUBOOT"
CONFIG_USB_CDC_ACM=y
CONFIG_USB_COMPOSITE_DEVICE=n
CONFIG_USB_MASS_STORAGE=n
CONFIG_USB_DEVICE_MANUFACTURER="Nordic Semiconductor"
CONFIG_USB_DEVICE_VID=0x1915
CONFIG_USB_DEVICE_PID=0x520F
```

## boot/zephyr/boards/nrf54h20dk_nrf54h20_cpuapp_iron_b0_mcuboot.conf
```kconfig
# Copyright (c) 2025 Nordic Semiconductor ASA
#
# SPDX-License-Identifier: Apache-2.0
#

# Ensure that the SPI NOR driver is disabled by default
CONFIG_SPI_NOR=n

# TODO: below are not yet supported and need fixing
CONFIG_FPROTECT=n

CONFIG_BOOT_WATCHDOG_FEED=n

CONFIG_MULTITHREADING=y
```

## boot/zephyr/boards/nrf54h20dk_nrf54h20_cpuapp_iron_ext_flash.conf
```kconfig
# Copyright (c) 2025 Nordic Semiconductor ASA
#
# SPDX-License-Identifier: Apache-2.0
#

CONFIG_SPI=y
CONFIG_FLASH=y
CONFIG_BOOT_MAX_IMG_SECTORS_AUTO=n
CONFIG_BOOT_MAX_IMG_SECTORS=512
CONFIG_FLASH_MSPI_NOR_LAYOUT_PAGE_SIZE=4096
```

## boot/zephyr/boards/nrf54l15dk_nrf54l15_cpuapp.conf
```kconfig
# Copyright (c) 2020 Nordic Semiconductor ASA
#
# SPDX-License-Identifier: Apache-2.0
#
# Ensure that the qspi driver is disabled by default
CONFIG_NORDIC_QSPI_NOR=n

# TODO: below are not yet supported and need fixing
CONFIG_NRF_RTC_TIMER=n
CONFIG_FPROTECT=n
CONFIG_BOOT_WATCHDOG_FEED=n
CONFIG_MULTITHREADING=y
```

## boot/zephyr/boards/nrf54l15dk_nrf54l15_cpuapp_ext_flash.conf
```kconfig
CONFIG_MULTITHREADING=y
CONFIG_SPI=y
CONFIG_SPI_NOR=y
CONFIG_FLASH=y
CONFIG_PM_PARTITION_SIZE_MCUBOOT=0x14000
CONFIG_MAIN_STACK_SIZE=20480
CONFIG_BOOT_MAX_IMG_SECTORS=512
CONFIG_SPI_NOR_FLASH_LAYOUT_PAGE_SIZE=4096
# Ensure that the qspi driver is disabled by default
CONFIG_NORDIC_QSPI_NOR=n

# TODO: below are not yet supported and need fixing
CONFIG_FPROTECT=n

CONFIG_BOOT_WATCHDOG_FEED=n

# Ensure the fastest RRAM write operations
CONFIG_NRF_RRAM_WRITE_BUFFER_SIZE=32
```

## boot/zephyr/boards/nrf54lm20dongle_nrf54lm20b_cpuapp.conf
```kconfig
#
# Copyright (c) 2026 Nordic Semiconductor ASA
#
# SPDX-License-Identifier: LicenseRef-Nordic-5-Clause
#

CONFIG_BOOT_FIRMWARE_LOADER_ENTRANCE_GPIO=y
CONFIG_BOOT_FIRMWARE_LOADER_NO_APPLICATION=y
CONFIG_GPIO=y
CONFIG_CRACEN_IKG=n
CONFIG_FPROTECT=y
CONFIG_BOOT_WATCHDOG_FEED=y
CONFIG_NRF_RRAM_WRITE_BUFFER_SIZE=32

# Disable run-time CRACEN provisioning of TRNG data.
# KMU slots 248, 249 shall be pre-provisioned while programming with secret TRNG values instead.
CONFIG_CRACEN_PROVISION_PROT_RAM_INV_SLOTS_ON_INIT=n

# Reduce memory consumption
CONFIG_LOG=n
CONFIG_BOOT_BANNER=n
CONFIG_NCS_BOOT_BANNER=n
CONFIG_NCS_APPLICATION_BOOT_BANNER_STRING=""
CONFIG_CLOCK_CONTROL=n
CONFIG_NRF_GRTC_START_SYSCOUNTER=n
CONFIG_SPI_NOR=n
CONFIG_SERIAL=n
CONFIG_CONSOLE=n
CONFIG_UART_CONSOLE=n
CONFIG_PRINTK=n
CONFIG_USE_SEGGER_RTT=n
CONFIG_SYS_CLOCK_EXISTS=n
CONFIG_NRF_GRTC_TIMER=n

# Activate Link Time Optimization (LTO)
CONFIG_LTO=y
CONFIG_ISR_TABLES_LOCAL_DECLARATION=y

# Improve debugging experience by disabling reset on fatal error
CONFIG_RESET_ON_FATAL_ERROR=n
```

## boot/zephyr/boards/thingy91v2_nrf9160.conf
```kconfig
# Disable Zephyr console
CONFIG_CONSOLE=n
CONFIG_CONSOLE_HANDLER=n
CONFIG_UART_CONSOLE=n

# MCUBoot settings
CONFIG_BOOT_MAX_IMG_SECTORS=512

CONFIG_SPI=y
CONFIG_SPI_NOR=y
CONFIG_SPI_NOR_SFDP_DEVICETREE=y
CONFIG_MULTITHREADING=y

# MCUboot serial recovery
CONFIG_MCUBOOT_SERIAL=y
```

## boot/zephyr/ironside_counters/Kconfig
```kconfig
#
# Copyright (c) 2025 Nordic Semiconductor ASA
#
# SPDX-License-Identifier: LicenseRef-Nordic-5-Clause
#

config NRF_MCUBOOT_IRONSIDE_COUNTERS
	bool "Use IronSide counters for MCUBoot hardware downgrade prevention"
	depends on MCUBOOT_HW_DOWNGRADE_PREVENTION && IRONSIDE_SE_CALL
	imply MCUBOOT_HW_DOWNGRADE_PREVENTION_LOCK
	help
	  Use IronSide SE hardware counters to prevent rollback of firmware images
	  in MCUBoot bootloader.
```

## boot/zephyr/uuid/Kconfig
```kconfig
#
# Copyright (c) 2025 Nordic Semiconductor ASA
#
# SPDX-License-Identifier: LicenseRef-Nordic-5-Clause
#

if MCUBOOT_UUID_VID || MCUBOOT_UUID_CID

menu "Vendor and image Class UUIDs"

choice NCS_MCUBOOT_UUID_IMPLEMENTATION
	prompt "UUID checks implementation"
	default NCS_MCUBOOT_UUID_SINGLE_VID

config NCS_MCUBOOT_UUID_SINGLE_VID
	bool "Single VID and one CID per image"
	help
	  This implementation allows to specify a single, common Vendor UUID
	  (VID) for all images and a unique Class UUID (CID) for each image.

endchoice # NCS_MCUBOOT_UUID_IMPLEMENTATION

if NCS_MCUBOOT_UUID_SINGLE_VID

config NCS_MCUBOOT_UUID_VID_VALUE
	string "Vendor name"
	default ""
	help
	  The vendor unique identifier.
	  The following formats are supported:
	   - Domain name (i.e. amce.corp) used to generate RFC 9562 UUID5
	     identifier.
	   - Raw UUID (i.e. 12345678-1234-5678-1234-567812345678)
	   - Raw HEX UUID (i.e. 12345678123456781234567812345678)

if MCUBOOT_UUID_CID

image=0
rsource "Kconfig.uuid.template"
image=1
rsource "Kconfig.uuid.template"
image=2
rsource "Kconfig.uuid.template"
image=3
rsource "Kconfig.uuid.template"
image=4
rsource "Kconfig.uuid.template"

endif # MCUBOOT_UUID_CID

endif # NCS_MCUBOOT_UUID_SINGLE_VID

endmenu

endif # MCUBOOT_UUID_VID || MCUBOOT_UUID_CID
```

## zephyr/Kconfig
```kconfig
menu "MCUboot"

if BOOTLOADER_MCUBOOT

config MCUBOOT_CMAKELISTS_DIR
	string "Path to the directory of the MCUBoot CMakeLists.txt file"
	default "$MCUBOOT_BASE/boot/zephyr/"


# The name of this configuration needs to match the requirements set by the
# script `partition_manager.py`. See `pm.yml` in the application directory
# of MCUBoot.
module=MCUBOOT
source "${ZEPHYR_BASE}/../nrf/subsys/partition_manager/Kconfig.template.build_strategy"

config MCUBOOT_IMAGE_VERSION
        string "Image version"
        default "0.0.0+0"
	help
	  Value to be passed as 'version' argument to 'imgtool.py' when
	  creating signed image. Note that no semantics are connected to
	  this variable. It does not provide downgrade prevention, and is only
	  valuable for debugging purposes. Format: maj.min.rev+build with
	  latter parts optional.

# HACK: NCS temphack to keep our imgtool integration working now that
# there is no CONFIG_DT_* CMake namespace anymore. Use Zephyr
# kconfigfunctions to thread the flash write block size through
# Kconfig so it can be accessed from CMake. Needs a better solution.
DT_ZEPHYR_FLASH := zephyr,flash
DT_CHOSEN_ZEPHYR_FLASH := $(dt_chosen_path,$(DT_ZEPHYR_FLASH))
config MCUBOOT_FLASH_WRITE_BLOCK_SIZE
	int
	default $(dt_node_int_prop_int,$(DT_CHOSEN_ZEPHYR_FLASH),write-block-size)

config BOOT_SIGNATURE_KEY_FILE
	# Duplicate from boot/zephyr/Kconfig to expose this option to the parent
	# image. Without this copy, it is not possible for the parent image to
	# be signed if the MCUBoot child image is not built from source.
	string "PEM key file"
	default "root-ec-p256.pem" if BOOT_SIGNATURE_TYPE_ECDSA_P256
	default "root-ed25519.pem" if BOOT_SIGNATURE_TYPE_ED25519
	default "root-rsa-3072.pem" if BOOT_SIGNATURE_TYPE_RSA && BOOT_SIGNATURE_TYPE_RSA_LEN=3072
	default "root-rsa-2048.pem" if BOOT_SIGNATURE_TYPE_RSA && BOOT_SIGNATURE_TYPE_RSA_LEN=2048
	help
	  You can use either absolute or relative path.
	  In case relative path is used, the build system assumes that it starts
	  from the directory where the MCUBoot KConfig configuration file is
	  located. If the key file is not there, the build system uses relative
	  path that starts from the MCUBoot repository root directory.
	  The key file will be parsed by imgtool's getpub command and a .c source
	  with the public key information will be written in a format expected by
	  MCUboot.

endif # BOOTLOADER_MCUBOOT

config DT_FLASH_WRITE_BLOCK_SIZE
	int
	default $(dt_node_int_prop_int,$(DT_CHOSEN_ZEPHYR_FLASH),write-block-size)

endmenu
```
