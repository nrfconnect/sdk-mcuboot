/*
 * Copyright (c) 2026 Nordic Semiconductor ASA
 *
 * SPDX-License-Identifier: LicenseRef-Nordic-5-Clause
 */

/ {
	chosen {
		zephyr,code-partition = &boot_partition;
	};
};

/* The configuration below is required for CONFIG_IRONSIDE_SE_CALL_MINIMAL=y */

/* The minimal IronSide call driver is in conflict with the Zephyr drivers for BELLBOARD. */
/delete-node/&cpusec_bellboard;
/delete-node/&cpusec_cpuapp_ipc;

/* Enable interrupt for SysCtrl IPC and no others.
 * The IronSide IPC RX event interrupt must be disabled.
 */
&cpuapp_bellboard {
	/* irq0:
	 *  - 6:  cpuapp-cpusys
	 */
	nordic,interrupt-mapping = <0x00000040 0>;
};
