## boot/zephyr/Kconfig.nrf53
```kconfig
# Copyright (c) 2023 Nordic Semiconductor ASA
#
# SPDX-License-Identifier: LicenseRef-Nordic-5-Clause
#

DT_COMPAT_SIM_FLASH:= zephyr,sim-flash
DT_SIM_FLASH_PATH:= $(dt_nodelabel_path,flash_sim0)

config BOOT_IMAGE_ACCESS_HOOK_NRF5340
	bool "Enable default nRF5340 hook"
	default y if BOOT_IMAGE_ACCESS_HOOKS
	depends on BOOT_IMAGE_ACCESS_HOOKS
	help
	  This enables the default nRF5340 image hook for MCUboot, which
	  supports upgrading the network core image from the application core.
	  To disable or override this feature, disable this option and add a
	  custom file using CMake.

config NRF53_MULTI_IMAGE_UPDATE
	bool "Support updating app core and net core in a single operation"
	default y
	depends on UPDATEABLE_IMAGE_NUMBER > 1
	depends on SOC_NRF5340_CPUAPP
	depends on BOOT_IMAGE_ACCESS_HOOKS
	depends on FLASH_SIMULATOR
	depends on FLASH_SIMULATOR_DOUBLE_WRITES
	depends on !FLASH_SIMULATOR_STATS
	depends on BOOT_UPGRADE_ONLY || USE_NRF53_MULTI_IMAGE_WITHOUT_UPGRADE_ONLY
	depends on $(dt_compat_enabled,$(DT_COMPAT_SIM_FLASH))
	select NRF53_MCUBOOT_PRIMARY_1_RAM_FLASH

config NRF53_RECOVERY_NETWORK_CORE
	bool "Serial recovery for the NET-core in the one image pair mode"
	depends on !NRF53_MULTI_IMAGE_UPDATE
	depends on SOC_NRF5340_CPUAPP
	depends on BOOT_IMAGE_ACCESS_HOOKS
	depends on FLASH_SIMULATOR
	depends on FLASH_SIMULATOR_DOUBLE_WRITES
	depends on !FLASH_SIMULATOR_STATS
	depends on MCUBOOT_SERIAL_DIRECT_IMAGE_UPLOAD
	depends on $(dt_compat_enabled,$(DT_COMPAT_SIM_FLASH))
	select NRF53_MCUBOOT_PRIMARY_1_RAM_FLASH
	help
	  If enabled, allows to upload the firmware to the network core
	  using serial recovery despite the fact that NRF53_MULTI_IMAGE_UPDATE
	  is not selected.

# hidden property for enabling the network core ram flash partition in PM
config NRF53_MCUBOOT_PRIMARY_1_RAM_FLASH
	bool

config NRF53_RAM_FLASH_SIZE
	hex
	depends on NRF53_MCUBOOT_PRIMARY_1_RAM_FLASH
	default $(dt_node_reg_size_hex,$(DT_SIM_FLASH_PATH))
	help
	  When performing a multi image update on the nRF53 the net core data
	  is read from external flash, and buffered in  RAM. This option is used
	  to define forward the size of this RAM region to the partition manager
	  configuration.
```
