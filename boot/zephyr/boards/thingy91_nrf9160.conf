## boot/zephyr/boards/thingy91_nrf9160.conf
```kconfig
# Disable Zephyr console
CONFIG_CONSOLE=n
CONFIG_CONSOLE_HANDLER=n
CONFIG_UART_CONSOLE=n

# Disable Flash protection
CONFIG_FPROTECT=n

# MCUBoot settings

# MCUboot serial recovery
CONFIG_MCUBOOT_SERIAL=y
```
